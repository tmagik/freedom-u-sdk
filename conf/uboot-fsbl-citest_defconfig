## conf/uboot-fsbl-citest_defconfig
```kconfig
CONFIG_RISCV=y
CONFIG_SYS_TEXT_BASE=0x08000000
CONFIG_NR_DRAM_BANKS=1
CONFIG_TARGET_SIFIVE_FU540=y
CONFIG_SIFIVE_DENALI=y
CONFIG_SIFIVE_LEGACY_MEMORY_INIT=y
CONFIG_ARCH_RV64I=y
CONFIG_DISTRO_DEFAULTS=y
CONFIG_FIT=y
CONFIG_BOOTCOMMAND="dhcp; env import -t ${fileaddr} ${filesize}; run boot2"
CONFIG_MISC_INIT_R=y
CONFIG_DISPLAY_CPUINFO=y
CONFIG_DISPLAY_BOARDINFO=y
CONFIG_CMD_BCB=y
CONFIG_CMD_CLK=y
CONFIG_CMD_PCI=y
CONFIG_CMD_SF=y
CONFIG_CMD_SF_TEST=y
CONFIG_CMD_SPI=y
CONFIG_DEFAULT_SPI_MODE=0x0
CONFIG_OF_EMBED=y
CONFIG_DEFAULT_DEVICE_TREE="hifive-unleashed-a00"
CONFIG_CACHE=y
CONFIG_MISC=y
CONFIG_EMEMORY_OTP=y
CONFIG_NVME=y
CONFIG_PCI=y
CONFIG_DM_PCI=y
CONFIG_PCIE_ECAM_GENERIC=y
CONFIG_PCI_XILINX=y
CONFIG_PCI_ENDPOINT=y
CONFIG_PCIE_CADENCE_EP=y
CONFIG_RAM=y
# CONFIG_SPECIFY_CONSOLE_INDEX is not set
# CONFIG_DM_SERIAL is not set
CONFIG_HIFIVE_SERIAL=y
CONFIG_VIRTIO_PCI=y
CONFIG_VIRTIO_NET=y
CONFIG_VIRTIO_BLK=y
```
